/*
 * Generic section layout for [N]Array. Run-model-independent: the per-part
 * memory script (generated by narray) defines the MEMORY regions and binds the
 * region aliases before INCLUDE-ing this file.
 *
 *   TEXT    where .isr_vector/.text/.rodata live (FLASH for ROM, SRAM for RAM)
 *   DATA    where .data/.bss run (SRAM)
 *   LOAD    where the .data initialiser image is stored (FLASH for ROM; for RAM
 *           LOAD == DATA, so LMA == VMA and the startup copy is a no-op)
 *   FAST    where NARRAY_FAST code runs: ITCM RAM on F7/H7 (copied at boot
 *           like .data), FLASH on G4 (VMA == LMA, the copy is a no-op)
 *   DMARAM  where NARRAY_DMABUF buffers live: a DMA-master-reachable SRAM.
 *           On H7 the general DMA cannot address DTCM — this alias is the
 *           placement policy. Aliases share the region's location counter,
 *           so DMARAM == DATA's region simply packs .dmabuf after .bss.
 *   SCRATCH the core-coupled RAM holding the stack and the crash record:
 *           CCMRAM on G4, DTCM RAM on F7/H7
 *
 * Provides _sidata/_sdata/_edata/_sbss/_ebss and _sifast/_sfast/_efast for
 * narray_init_memory() in lib/startup.h. The vector table (.isr_vector) is the
 * application-owned array; EXTERN keeps it even though nothing references it
 * before VTOR is set.
 */

ENTRY(Reset_Handler)
EXTERN(__vectors)

SECTIONS
{
  .isr_vector : {
    . = ALIGN(4);
    KEEP(*(.isr_vector))
    . = ALIGN(4);
  } > TEXT

  .text : {
    . = ALIGN(4);
    _stext = .;                  /* code span, for the fault backtrace scanner */
    *(.text) *(.text.*)
    *(.rodata) *(.rodata.*)
    . = ALIGN(4);
    _etext = .;
  } > TEXT

  /* NARRAY_FAST code: deadline handlers. Copied by narray_init_memory() like
     .data; where FAST is bound to flash the copy is a VMA == LMA no-op. */
  .fast : {
    . = ALIGN(4);
    _sfast = .;
    *(.fast) *(.fast.*)
    . = ALIGN(4);
    _efast = .;
  } > FAST AT> LOAD
  _sifast = LOADADDR(.fast);

  .data : {
    . = ALIGN(4);
    _sdata = .;
    *(.data) *(SORT_BY_ALIGNMENT(.data.*))
    . = ALIGN(4);
    _edata = .;
  } > DATA AT> LOAD
  _sidata = LOADADDR(.data);  /* .data source: flash for ROM, == _sdata for RAM */

  .bss : {
    . = ALIGN(4);
    _sbss = .;
    *(.bss) *(SORT_BY_ALIGNMENT(.bss.*)) *(COMMON)
    . = ALIGN(4);
    _ebss = .;
  } > DATA

  /* NARRAY_DMABUF buffers: NOLOAD and deliberately NOT zeroed at boot — like
     any DMA ring, the owner initialises before starting the controller. */
  .dmabuf (NOLOAD) : {
    . = ALIGN(4);
    *(.dmabuf) *(.dmabuf.*)
    . = ALIGN(4);
  } > DMARAM

  /* RAM-model hooks, inert here: empty code-copy span */
  _sitext = 0;
  _stextcpy = 0;
  _etextcpy = 0;

  /* lib/fault.c crash record at the low end of SCRATCH (NOLOAD: not zeroed at
     boot, survives reset). The stack grows down from _estack (top of SCRATCH);
     _stack_limit leaves the record plus a guard gap below it. */
  .crashdump (NOLOAD) : {
    . = ALIGN(8);
    KEEP(*(.crashdump))
    . = ALIGN(8);
  } > SCRATCH
  _stack_limit = ORIGIN(SCRATCH) + SIZEOF(.crashdump) + 256; /* + guard gap */

  /DISCARD/ : {
    *(.ARM.exidx) *(.ARM.exidx.*) /* unwind tables: unused, and disturb .data init */
  }
}
